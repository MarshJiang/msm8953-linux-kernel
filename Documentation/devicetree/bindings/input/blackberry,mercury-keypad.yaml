## Documentation/devicetree/bindings/input/blackberry,mercury-keypad.yaml
```yaml
# SPDX-License-Identifier: (GPL-2.0-only OR BSD-2-Clause)
%YAML 1.2
---
$id: http://devicetree.org/schemas/input/blackberry,mercury-keypad.yaml#
$schema: http://devicetree.org/meta-schemas/core.yaml#

title: BlackBerry KEYone Keyboard Controller

maintainers:
  - MarshJiang <1208879283@qq.com>

description:
  The BlackBerry KEYone contains an I2C keyboard controller that scans the
  built-in physical keyboard and reports key transitions through a FIFO.

allOf:
  - $ref: matrix-keymap.yaml#

properties:
  compatible:
    const: blackberry,mercury-keypad

  reg:
    maxItems: 1

  interrupts:
    maxItems: 1

  i2c-supply:
    description: Supply for the keyboard controller I2C interface

  reset-gpios:
    maxItems: 1

  wakeup-source: true

required:
  - compatible
  - reg
  - interrupts
  - i2c-supply
  - reset-gpios
  - keypad,num-rows
  - keypad,num-columns
  - linux,keymap

unevaluatedProperties: false

examples:
  - |
    #include <dt-bindings/gpio/gpio.h>
    #include <dt-bindings/input/input.h>
    #include <dt-bindings/interrupt-controller/irq.h>

    i2c {
        #address-cells = <1>;
        #size-cells = <0>;

        keyboard@40 {
            compatible = "blackberry,mercury-keypad";
            reg = <0x40>;

            interrupt-parent = <&tlmm>;
            interrupts = <12 IRQ_TYPE_LEVEL_LOW>;
            i2c-supply = <&keyboard_i2c_vreg>;
            reset-gpios = <&tlmm 66
                           (GPIO_ACTIVE_LOW | GPIO_OPEN_DRAIN)>;

            keypad,num-rows = <8>;
            keypad,num-columns = <8>;
            linux,keymap = <MATRIX_KEY(3, 1, KEY_Q)>;
        };
    };
```

## Documentation/devicetree/bindings/sound/qcom,wsa881x-i2c.yaml
```yaml
# SPDX-License-Identifier: (GPL-2.0-only OR BSD-2-Clause)
%YAML 1.2
---
$id: http://devicetree.org/schemas/sound/qcom,wsa881x-i2c.yaml#
$schema: http://devicetree.org/meta-schemas/core.yaml#

title: Qualcomm WSA8810/WSA8815 I2C/PDM speaker amplifier

maintainers:
  - Linux ARM MSM mailing list <linux-arm-msm@vger.kernel.org>

description:
  The WSA8810 and WSA8815 are Class-D smart speaker amplifiers. Older
  platforms control separate digital and analog register banks over two I2C
  addresses and feed analog audio to the amplifier from the internal codec.

allOf:
  - $ref: dai-common.yaml#

properties:
  compatible:
    const: qcom,wsa881x-i2c

  reg:
    items:
      - description: Digital register bank
      - description: Analog register bank

  reg-names:
    items:
      - const: digital
      - const: analog

  reset-gpios:
    description: Active-low SD_N reset and shutdown pin
    maxItems: 1

  vdd-supply:
    description: Regulator for the external WSA supply switch

  sound-name-prefix: true

required:
  - compatible
  - reg
  - reg-names
  - reset-gpios
  - vdd-supply

additionalProperties: false

examples:
  - |
    #include <dt-bindings/gpio/gpio.h>

    vdd_wsa: regulator {
        compatible = "regulator-fixed";
        regulator-name = "vdd-wsa";
    };

    i2c {
        #address-cells = <1>;
        #size-cells = <0>;

        amplifier@e {
            compatible = "qcom,wsa881x-i2c";
            reg = <0x0e>, <0x44>;
            reg-names = "digital", "analog";
            reset-gpios = <&tlmm 96 GPIO_ACTIVE_LOW>;
            vdd-supply = <&vdd_wsa>;
            sound-name-prefix = "Speaker";
        };
    };
...
```
